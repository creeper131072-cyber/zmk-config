// Fn を押しながら: E は絵文字、F はフルスクリーン（Mac と同じ）
#include "../../config/kb78.keymap"
#include <dt-bindings/zmk/kscan_mock.h>

// テスト用の仮のキー読み取り: 1行×79列。列番号 = kb78.keymap のキー番号
&kscan {
    rows = <1>;
    columns = <79>;
    events = <
        ZMK_MOCK_PRESS(0,74,10)
        ZMK_MOCK_PRESS(0,31,10)
        ZMK_MOCK_RELEASE(0,31,10)
        ZMK_MOCK_PRESS(0,46,10)
        ZMK_MOCK_RELEASE(0,46,10)
        ZMK_MOCK_RELEASE(0,74,10)
    >;
};
