// Fn を先に離しても、押したときの F1 がきちんと離される。その後の F1 は明るさに戻る
#include "../../config/kb78.keymap"
#include <dt-bindings/zmk/kscan_mock.h>

// テスト用の仮のキー読み取り: 1行×79列。列番号 = kb78.keymap のキー番号
&kscan {
    rows = <1>;
    columns = <79>;
    events = <
        ZMK_MOCK_PRESS(0,74,10)
        ZMK_MOCK_PRESS(0,1,10)
        ZMK_MOCK_RELEASE(0,74,10)
        ZMK_MOCK_RELEASE(0,1,10)
        ZMK_MOCK_PRESS(0,1,10)
        ZMK_MOCK_RELEASE(0,1,10)
    >;
};
