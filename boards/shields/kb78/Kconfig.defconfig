## boards/shields/kb78/Kconfig.defconfig
```kconfig
if SHIELD_KB78

# Bluetoothで見える名前（16文字まで）
config ZMK_KEYBOARD_NAME
    default "KB78"

endif
```

## config/west.yml
```yaml
manifest:
  remotes:
    - name: zmkfirmware
      url-base: https://github.com/zmkfirmware
  projects:
    - name: zmk
      remote: zmkfirmware
      # zmk-pro-rgb（キーごとのLED）が main を前提にしているため main を使う
      revision: main
      import: app/west.yml
  self:
    path: config
```
